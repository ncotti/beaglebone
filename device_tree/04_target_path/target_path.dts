/* Inserting multiple devices on different paths, which already existed in the
* original device tree */

/dts-v1/;
/plugin/;

// If the path already exists, the whole target is not overwritten.
&{/chosen} {
    // This new properties get written in /proc/device-tree/chosen
    new_property = "new";

    // Already existing properties get overwritten when modified.
    base_dtb_timestamp = "Sat Jan 1 11:22:33 2023";

    // /proc/device-tree/chosen/overlays already exists aswell, it is not overwritten
    overlays {
        new_overlay = "new";
    };
};

// Using two fragments. Both modifications are implemented in the device tree
&{/leds/led5} {
    // Overwrite property. You can see the changes on the device tree, or on
    // /sys/class/leds/led_label_changed (prior was "beaglebone:green:usr3")
    label = "led_label_changed";
};

