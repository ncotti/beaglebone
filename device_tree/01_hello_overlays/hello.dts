/* First approach to device tree overlays.*/

/dts-v1/;   // Version
/plugin/;   // Needed to indicate that this is an OVERLAY, and not a raw device tree.

// &{<path_in_device_tree>} marks the insertion point for the device tree overlay.
// Every element from a device tree can be referenced using a path notation like "/first_node/second_node"
// In this example, we are inserting this code in the root folder "/", which corresponds with /proc/device-tree/
&{/} {
    hello_device {
        compatible = "cotti,driver";
        status = "okay";
        label = "Hello";
    };
};
