/* Simple device tree overlay. Creates a device in the root path of the DT */

/dts-v1/;
/plugin/;

&{/} {
    my_device {
        // Properties for the device "/proc/device-tree/my_device". They appear as files in that folder
        compatible = "cotti,driver";   // This line is used to associate the device to its driver.
        status = "okay";
        label = "Test";
        my-value = <12>;
    };
};
