/* This is a very simple, barebone device tree overlay. */

/dts-v1/;
/plugin/;

&{/} {
    my_device {
        compatible = "cotti,driver";
        status = "okay";
        label = "Test";
        my-value = <12>;
        green-led-gpios = <&gpio1 0x1c 0x00>;
    };
};
